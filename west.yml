## west.yml
```yaml
# The west manifest file for upstream Zephyr.
#
# The per-installation west configuration file, .west/config, sets the
# path to the project containing this file in the [manifest] section's
# "path" variable.
#
# You are free to create your own manifest files and put them in any
# repository you want, to create your own custom Zephyr installations.
# For example, you could create a manifest file in your own out of
# tree application directory, which would pull this zephyr repository
# in as an ordinary project.
#
# You can pass your manifest repositories to west init when creating a
# new Zephyr installation. See the west documentation for more
# information.

manifest:
  defaults:
    remote: upstream

  remotes:
    - name: upstream
      url-base: https://github.com/zephyrproject-rtos
    - name: babblesim
      url-base: https://github.com/BabbleSim

  group-filter: [-babblesim, -optional]

  #
  # Please add items below based on alphabetical order
  projects:
    - name: acpica
      revision: 8d24867bc9c9d81c81eeac59391cda59333affd4
      path: modules/lib/acpica
    - name: bsim
      repo-path: babblesim-manifest
      revision: 9351ae1ad44864a49c351f9704f65f43046abeb0
      path: tools/bsim
      groups:
        - babblesim
    - name: babblesim_base
      remote: babblesim
      repo-path: base
      path: tools/bsim/components
      revision: 4bd907be0b2abec3b31a23fd8ca98db2a07209d2
      groups:
        - babblesim
    - name: babblesim_ext_2G4_libPhyComv1
      remote: babblesim
      repo-path: ext_2G4_libPhyComv1
      path: tools/bsim/components/ext_2G4_libPhyComv1
      revision: 93f5eba512c438b0c9ebc1b1a947517c865b3643
      groups:
        - babblesim
    - name: babblesim_ext_2G4_phy_v1
      remote: babblesim
      repo-path: ext_2G4_phy_v1
      path: tools/bsim/components/ext_2G4_phy_v1
      revision: 04eeb3c3794444122fbeeb3715f4233b0b50cfbb
      groups:
        - babblesim
    - name: babblesim_ext_2G4_channel_NtNcable
      remote: babblesim
      repo-path: ext_2G4_channel_NtNcable
      path: tools/bsim/components/ext_2G4_channel_NtNcable
      revision: 20a38c997f507b0aa53817aab3d73a462fff7af1
      groups:
        - babblesim
    - name: babblesim_ext_2G4_channel_multiatt
      remote: babblesim
      repo-path: ext_2G4_channel_multiatt
      path: tools/bsim/components/ext_2G4_channel_multiatt
      revision: bde72a57384dde7a4310bcf3843469401be93074
      groups:
        - babblesim
    - name: babblesim_ext_2G4_modem_magic
      remote: babblesim
      repo-path: ext_2G4_modem_magic
      path: tools/bsim/components/ext_2G4_modem_magic
      revision: edfcda2d3937a74be0a59d6cd47e0f50183453da
      groups:
        - babblesim
    - name: babblesim_ext_2G4_modem_BLE_simple
      remote: babblesim
      repo-path: ext_2G4_modem_BLE_simple
      path: tools/bsim/components/ext_2G4_modem_BLE_simple
      revision: a38d2d24b04a6f970a225d1316047256ebf5a539
      groups:
        - babblesim
    - name: babblesim_ext_2G4_device_burst_interferer
      remote: babblesim
      repo-path: ext_2G4_device_burst_interferer
      path: tools/bsim/components/ext_2G4_device_burst_interferer
      revision: 5b5339351d6e6a2368c686c734dc8b2fc65698fc
      groups:
        - babblesim
    - name: babblesim_ext_2G4_device_WLAN_actmod
      remote: babblesim
      repo-path: ext_2G4_device_WLAN_actmod
      path: tools/bsim/components/ext_2G4_device_WLAN_actmod
      revision: 9cb6d8e72695f6b785e57443f0629a18069d6ce4
      groups:
        - babblesim
    - name: babblesim_ext_2G4_device_playback
      remote: babblesim
      repo-path: ext_2G4_device_playback
      path: tools/bsim/components/ext_2G4_device_playback
      revision: abb48cd71ddd4e2a9022f4bf49b2712524c483e8
      groups:
        - babblesim
    - name: babblesim_ext_libCryptov1
      remote: babblesim
      repo-path: ext_libCryptov1
      path: tools/bsim/components/ext_libCryptov1
      revision: eed6d7038e839153e340bd333bc43541cb90ba64
      groups:
        - babblesim
    - name: cmsis
      revision: 4b96cbb174678dcd3ca86e11e1f24bc5f8726da0
      path: modules/hal/cmsis
      groups:
        - hal
    - name: cmsis-dsp
      revision: 6489e771e9c405f1763b52d64a3f17a1ec488ace
      path: modules/lib/cmsis-dsp
    - name: cmsis-nn
      revision: ea987c1ca661be723de83bd159aed815d6cbd430
      path: modules/lib/cmsis-nn
    - name: edtt
      revision: b9ca3c7030518f07b7937dacf970d37a47865a76
      path: tools/edtt
      groups:
        - tools
    - name: fatfs
      revision: 427159bf95ea49b7680facffaa29ad506b42709b
      path: modules/fs/fatfs
      groups:
        - fs
    - name: hal_freqchip
      revision: 0657d9f97d973542e438f628a704f5d8ea0cdef5
      path: modules/hal/freqchip
      groups:
        - hal
    - name: libmetal
      revision: a6851ba6dba8c9e87d00c42f171a822f7a29639b
      path: modules/hal/libmetal
      groups:
        - hal
    - name: liblc3
      revision: 1a5938ebaca4f13fe79ce074f5dee079783aa29f
      path: modules/lib/liblc3
    - name: littlefs
      path: modules/fs/littlefs
      groups:
        - fs
      revision: 408c16a909dd6cf128874a76f21c793798c9e423
    - name: loramac-node
      revision: fb00b383072518c918e2258b0916c996f2d4eebe
      path: modules/lib/loramac-node
    - name: mbedtls
      revision: be1dd5b11d8f59af0ab0995985e348a429999013
      path: modules/crypto/mbedtls
      groups:
        - crypto
    - name: mipi-sys-t
      path: modules/debug/mipi-sys-t
      groups:
        - debug
      revision: 71ace1f5caa03e56c8740a09863e685efb4b2360
    - name: percepio
      path: modules/debug/percepio
      revision: 0d44033c744978ca2505a06640b4f6964c5411e6
      groups:
        - debug
    - name: picolibc
      path: modules/lib/picolibc
      revision: 764ef4e401a8f4c6a86ab723533841f072885a5b
    - name: segger
      revision: b011c45b585e097d95d9cf93edf4f2e01588d3cd
      path: modules/debug/segger
      groups:
        - debug
    - name: tinycrypt
      revision: 1012a3ebee18c15ede5efc8332ee2fc37817670f
      path: modules/crypto/tinycrypt
      groups:
        - crypto
    - name: uoscore-uedhoc
      revision: 84ef879a46d7bfd9a423fbfb502b04289861f9ea
      path: modules/lib/uoscore-uedhoc
    - name: zcbor
      revision: 75d088037eb237b18e7ec1f47c9ce494b9b95aab
      path: modules/lib/zcbor

  self:
    path: zephyr
    west-commands: scripts/west-commands.yml
    import: submanifests
```
