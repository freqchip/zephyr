## boards/freqchip/FR8029D_BIB/Kconfig.fr8029D_BIB
```kconfig
# Copyright (c) 2026 Freqchip
# SPDX-License-Identifier: Apache-2.0

config BOARD_FR8029D_BIB
	bool "Freqchip FR8029D_BIB board"
	select SOC_FR8029D
```

## boards/freqchip/FR8029D_BIB/fr8029D_bib_defconfig
```kconfig
# Copyright (c) 2026 Freqchip
# SPDX-License-Identifier: Apache-2.0

# --- 硬件保护 ---
# 关闭 ARM MPU（本 SoC 无 MPU 或暂时不使用）
CONFIG_ARM_MPU=n
# 关闭 HW 栈溢出检测（无 MPU 支持时不能开启）
CONFIG_HW_STACK_PROTECTION=n
# 主线程栈大小（字节）
CONFIG_MAIN_STACK_SIZE=5120

# --- 串口 & 控制台 ---
# 启用 Zephyr 串口驱动框架
CONFIG_SERIAL=y
CONFIG_UART_INTERRUPT_DRIVEN=y
# 启用 Zephyr 控制台子系统
CONFIG_CONSOLE=y
CONFIG_UART_CONSOLE=y
CONFIG_STDOUT_CONSOLE=n
# --- shell ---
CONFIG_SHELL=y
CONFIG_SHELL_BACKEND_SERIAL=y
CONFIG_SHELL_BACKEND_SERIAL_API_INTERRUPT_DRIVEN=y
CONFIG_SHELL_BACKEND_SERIAL_TX_RING_BUFFER_SIZE=64
CONFIG_SHELL_BACKEND_SERIAL_RX_RING_BUFFER_SIZE=64

# --- 电源管理 ---
CONFIG_PM=y                            # 系统 PM 基础（depends on SYS_CLOCK_EXISTS && HAS_PM）
CONFIG_PM_DEVICE=y                     # 设备电源管理接口
CONFIG_PM_DEVICE_SYSTEM_MANAGED=y      # 系统级自动管理（睡眠时自动挂起所有设备）
CONFIG_PM_DEVICE_RUNTIME=y             # 运行时 PM：单设备 get/put 引用计数

# --- 中断 ---
CONFIG_DYNAMIC_INTERRUPTS=y
# --- GPIO ---
CONFIG_GPIO=y
CONFIG_LED=y
# --- ADC ---
CONFIG_ADC=y
# --- I2C ---
CONFIG_I2C=y
# --- PINCTRL ---
CONFIG_PINCTRL=y
# --- WDT ---
CONFIG_WATCHDOG=y
# --- CAN ---
CONFIG_CAN=y
CONFIG_CAN_FD_MODE=y
CONFIG_CAN_MANUAL_RECOVERY_MODE=y
# --- bluetooth ---
CONFIG_BT=y
CONFIG_BT_CTLR=n
CONFIG_BT_HCI=y

# --- THREAD_PRIORITY ---
CONFIG_MAIN_THREAD_PRIORITY=0
CONFIG_SHELL_THREAD_PRIORITY_OVERRIDE=y
CONFIG_SHELL_THREAD_PRIORITY=5

# --- 硬浮点 ABI ---
CONFIG_FPU=y
CONFIG_FPU_SHARING=y
CONFIG_FP_HARDABI=y

# --- C 标准库 ---
# 使用 picolibc
CONFIG_PICOLIBC=y

# --- 禁用Zephyr内存管理 ---
CONFIG_COMMON_LIBC_MALLOC=n

# --- tick 1KHz ---
CONFIG_SYS_CLOCK_TICKS_PER_SEC=1000


# --- 可选 picolibc 功能（按需开启，四选一） ---
# 完整整数 + 浮点数支持（%f %lf）
CONFIG_PICOLIBC_IO_FLOAT=y
# 极简整数 printf（裁剪体积，不含浮点数/long long/宽字符）
# CONFIG_PICOLIBC_IO_MINIMAL=y
```

## drivers/adc/Kconfig.freqchip
```kconfig
# ADC configuration options

# Copyright (c) 2026 Freqchip
# SPDX-License-Identifier: Apache-2.0

config ADC_FREQCHIP
	bool "Freqchip SARADC driver"
	default y
	depends on DT_HAS_FREQCHIP_FREQCHIP_SARADC_ENABLED
	select ADC_CONFIGURABLE_INPUTS
	help
	  Enable SARADC driver for Freqchip FR802x series MCUs.
```

## drivers/can/Kconfig.freqchip
```kconfig
# Copyright (c) 2026 Freqchip
# SPDX-License-Identifier: Apache-2.0

config CAN_FREQCHIP
	bool "Freqchip CAN driver"
	default y
	depends on DT_HAS_FREQCHIP_FREQCHIP_CAN_ENABLED
	help
	  Enable the CAN driver for Freqchip FR802x series MCUs.
```

## drivers/i2c/Kconfig.freqchip
```kconfig
# Copyright (c) 2026 Freqchip
# SPDX-License-Identifier: Apache-2.0

config I2C_FREQCHIP
	bool "Freqchip I2C driver"
	default y
	depends on DT_HAS_FREQCHIP_FREQCHIP_I2C_ENABLED
	help
	  Enable the I2C driver for Freqchip FR802x series MCUs.
```

## drivers/pinctrl/Kconfig.freqchip
```kconfig
# Copyright (c) 2026 Freqchip
# SPDX-License-Identifier: Apache-2.0

config PINCTRL_FREQCHIP
	bool "Freqchip pin controller driver"
	default y
	depends on DT_HAS_FREQCHIP_FREQCHIP_PINCTRL_ENABLED
	help
	  Pin controller driver for Freqchip FR platforms.
	  Implements pin multiplexing via the system GPIO controller.
```

## drivers/serial/Kconfig.freqchip
```kconfig
# Copyright (c) 2026 Freqchip
# SPDX-License-Identifier: Apache-2.0

config USART_FREQCHIP
	bool "Freqchip serial driver"
	default y
	depends on DT_HAS_FREQCHIP_FREQCHIP_USART_ENABLED
	select SERIAL_HAS_DRIVER
	help
	  This option enables the USART driver for Freqchip SoC family.
```

## drivers/watchdog/Kconfig.freqchip
```kconfig
# Copyright (c) 2026 Freqchip
# SPDX-License-Identifier: Apache-2.0

config WDT_FREQCHIP
	bool "Freqchip WDT driver"
	default y
	depends on DT_HAS_FREQCHIP_FREQCHIP_WDT_ENABLED
	help
	  Enable the Watchdog Timer (WDT) driver for Freqchip FR802x series MCUs.
```

## dts/bindings/adc/freqchip,freqchip-saradc.yaml
```yaml
# Copyright (c) 2026 Freqchip
# SPDX-License-Identifier: Apache-2.0

description: Freqchip SARADC Controller

compatible: "freqchip,freqchip-saradc"

include: base.yaml

properties:
  reg:
    required: true

  interrupts:
    required: false

  channels:
    type: int
    required: true
    description: |
      Number of available ADC channels.
      Maximum 32 for FR802x SARADC.

  clk-div:
    type: int
    default: 10
    description: |
      SARADC clock divider. Must be a multiple of 2. Max 254.

  sampling-cycle:
    type: int
    default: 16
    description: |
      SARADC sampling cycle. Value from 1 to 16.

  reference:
    type: int
    default: 0
    description: |
      Reference voltage source.
      0 = IOLDO, 1 = External, 2 = Internal 1.2V,
      3 = Internal 1.5V, 4 = Internal 1.8V, 5 = Internal 2.4V.

  "#io-channel-cells":
    type: int
    const: 1

  "#address-cells":
    type: int
    const: 1

  "#size-cells":
    type: int
    const: 0

child-binding:
  description: |
    Freqchip SARADC channel configuration.
    All properties are optional, configure only what you need.

  properties:
    reg:
      type: int
      required: false
      description: Channel identifier.

    zephyr,gain:
      type: string
      required: false
      description: ADC gain setting.

    zephyr,reference:
      type: string
      required: false
      description: ADC reference voltage source.

    zephyr,acquisition-time:
      type: int
      required: false
      description: ADC acquisition time.

    zephyr,differential:
      type: boolean
      description: Enable differential input mode.

    zephyr,input-positive:
      type: int
      description: Positive ADC input mapping.

    zephyr,input-negative:
      type: int
      description: Negative ADC input mapping.

    freqchip,voltage-divider:
      type: int
      default: 0
      enum:
        - 0    # SARADC_VOLTAGE_DIVIDER_BYPASS (直通)
        - 1    # SARADC_VOLTAGE_DIVIDER_0P25  (1/4 分压)
        - 2    # SARADC_VOLTAGE_DIVIDER_0P5   (1/2 分压)
      description: |
        Input voltage divider selection.
        0 = bypass (no divider)
        1 = 1/4 voltage divider
        2 = 1/2 voltage divider

    freqchip,source-follower:
      type: boolean
      description: |
        Enable source follower for this channel.

io-channel-cells:
  - input
```

## dts/bindings/bluetooth/freqchip,fr802x-bt-hci.yaml
```yaml
description: Bluetooth HCI for Freqchip FR802X (in-chip memory based)

compatible: "freqchip,fr802x-bt-hci"

include: bt-hci.yaml

properties:
  bt-hci-name:
    default: "BT FR802X"
  bt-hci-bus:
    default: "BT_HCI_BUS_VIRTUAL"
  bt-hci-quirks:
    default: ["BT_HCI_QUIRK_NO_AUTO_DLE"]
```

## dts/bindings/can/freqchip,freqchip-can.yaml
```yaml
# SPDX-License-Identifier: Apache-2.0

description: |
  Freqchip FR802x MACAN CAN FD controller.

  This controller supports both Classical CAN and CAN FD frames.
  Unlike STM32 FDCAN, the FR802x MACAN block is not Bosch M_CAN compatible,
  so the message RAM layout is fixed internally by the driver instead of being
  described through a dedicated devicetree property.

compatible: "freqchip,freqchip-can"

include: ["can-fd-controller.yaml", "pinctrl-device.yaml"]

properties:
  reg:
    required: true

  interrupts:
    required: true

  interrupt-names:
    description: |
      Optional names of the two MACAN interrupt lines. If present, they should
      be "int0" and "int1".

  pinctrl-0:
    required: true

  pinctrl-names:
    required: true
```

## dts/bindings/gpio/freqchip,freqchip-gpio.yaml
```yaml
# Copyright (c) 2025 Freqchip
# SPDX-License-Identifier: Apache-2.0

description: Freqchip GPIO Controller

compatible: "freqchip,freqchip-gpio"

include: [gpio-controller.yaml, base.yaml]

properties:
  reg:
    required: true

  clocks:
    required: false

  "#gpio-cells":
    const: 2

gpio-cells:
  - pin
  - flags
```

## dts/bindings/i2c/freqchip,freqchip-i2c.yaml
```yaml
# Copyright (c) 2026 Freqchip
# SPDX-License-Identifier: Apache-2.0

description: Freqchip I2C Controller

compatible: "freqchip,freqchip-i2c"

include: [i2c-controller.yaml, pinctrl-device.yaml]

properties:
  reg:
    required: true

  interrupts:
    required: true

  pinctrl-0:
    required: true

  pinctrl-names:
    required: true
```

## dts/bindings/pinctrl/freqchip.fr-pinctrl.yaml
```yaml
# Copyright (c) 2025 Freqchip
# SPDX-License-Identifier: Apache-2.0

description: |
    Freqchip Pin controller.
    
compatible: "freqchip,freqchip-pinctrl"

include: base.yaml

properties:
  reg:
    required: true
    
child-binding:
  description: |
      This binding gives a base representation of the Freqchip pins configuration
      
  include:
    - name: pincfg-node.yaml
      property-allowlist:
        - bias-disable
        - bias-pull-down
        - bias-pull-up
        - drive-push-pull
        - drive-open-drain
        - output-low
        - output-high

  properties:
    pinmux:
      required: true
      type: int
      description: |
        Freqchip io Alternate function selection (port, pin and function)
        For example: ['A', 0, 1] means set PA0 to function 1.
```

## dts/bindings/serial/freqchip,freqchip-usart.yaml
```yaml
# Copyright (c) 2025 Freqchip
# SPDX-License-Identifier: Apache-2.0

description: Freqchip FR USART

compatible: "freqchip,freqchip-usart"

include: [uart-controller.yaml, pinctrl-device.yaml]

properties:
  reg:
    required: true

  clocks:
    type: phandle-array

  resets:
    type: phandle-array

  interrupts:
    required: true

  current-speed:
    description: |
      Initial baud rate setting for UART. Defaults to standard baudrate of 115200 if not specified.
    default: 115200

  stop-bits:
    description: |
      Sets the number of stop bits. Defaults to standard of 1 if not specified.
    default: "1"

  data-bits:
    description: |
      Sets the number of data bits. Defaults to standard of 8 if not specified.
    default: 8

  tx-fifo-empty-threshold:
    type: int
    description: |
      Specifies the Tx FIFO almost empty threshold. This parameter can be a 4bit value
    default: 8

  rx-fifo-full-threshold:
    type: int
    description: |
      Specifies the Rx FIFO almost full threshold. This parameter can be a 4bit value
    default: 8
```

## dts/bindings/watchdog/freqchip,freqchip-wdt.yaml
```yaml
# Copyright (c) 2026 Freqchip
#
# SPDX-License-Identifier: Apache-2.0

description: Freqchip FR802x Watchdog Timer (WDT)

compatible: "freqchip,freqchip-wdt"

include: base.yaml

properties:
  reg:
    required: true

  clock-frequency:
    type: int
    required: true
    description: |
      Clock frequency of the WDT counter in Hz.
      The timeout is calculated as: counter = clock_frequency * timeout_ms / 1000
```

## samples/boards/freqchip/driver_test/sample.yaml
```yaml
sample:
  description: Freqchip FR8029D driver test sample
  name: driver test
common:
  tags: drivers
  integration_platforms:
    - fr8029D_BIB
  harness: console
  harness_config:
    type: one_line
    regex:
      - "Driver Test! (.*)"
tests:
  sample.drivers.driver_test:
    tags: drivers
```

## soc/freqchip/freq/Kconfig
```kconfig
# Copyright (c) 2026 Freqchip
# SPDX-License-Identifier: Apache-2.0

config SOC_FAMILY_FREQCHIP_FR
	bool
	select HAS_FREQCHIP_DRIVERS
	select BUILD_OUTPUT_HEX

if SOC_FAMILY_FREQCHIP_FR

rsource "*/Kconfig"

endif # SOC_FAMILY_FREQCHIP_FR
```

## soc/freqchip/freq/Kconfig.defconfig
```kconfig
# Copyright (c) 2021, ATL Electronics
# SPDX-License-Identifier: Apache-2.0

if SOC_FAMILY_FREQCHIP_FR

rsource "*/Kconfig.defconfig.series"

endif # SOC_FAMILY_FREQCHIP_FR
```

## soc/freqchip/freq/Kconfig.soc
```kconfig
# Copyright (c) 2026 Open-RnD Sp. z o.o.
# SPDX-License-Identifier: Apache-2.0

config SOC_FAMILY_FREQCHIP_FR
	bool

config SOC_FAMILY
	default "freqchip_fr" if SOC_FAMILY_FREQCHIP_FR

rsource "*/Kconfig.soc"
```

## soc/freqchip/freq/fr802x/Kconfig
```kconfig
# Copyright (c) 2025 Freqchip
# SPDX-License-Identifier: Apache-2.0

config SOC_SERIES_FR802X
    select XIP
    select HAS_PM
    select HAS_CUSTOM_LIBC_MALLOC
    select ARM
    select CPU_CORTEX_M33
    select CPU_CORTEX_M_HAS_SYSTICK
    select CPU_HAS_FPU
    select CPU_HAS_VFP
    select VFP_SP_D16
    select CPU_HAS_ARM_MPU
    select CPU_HAS_TEE
    select ARMV8_M_DSP
    select SOC_EARLY_INIT_HOOK
    select OUTPUT_DISASSEMBLY
    select SERIAL_SUPPORT_INTERRUPT
```

## soc/freqchip/freq/fr802x/Kconfig.defconfig.fr8029D
```kconfig
# Copyright (c) 2025 Freqchip
# SPDX-License-Identifier: Apache-2.0

if SOC_FR8029D

config SYS_CLOCK_HW_CYCLES_PER_SEC
	default $(dt_node_int_prop_int,/cpus/cpu@0,clock-frequency)

config NUM_IRQS
	default 69

endif # SOC_FR8029D
```

## soc/freqchip/freq/fr802x/Kconfig.soc
```kconfig
# Copyright (c) 2025 Freqchip
# SPDX-License-Identifier: Apache-2.0

config SOC_SERIES_FR802X
	bool
	select SOC_FAMILY_FREQCHIP_FR

config SOC_SERIES
	default "fr802x" if SOC_SERIES_FR802X

config SOC_FR8029D
	bool
	select SOC_SERIES_FR802X

config SOC
	default "fr8029D" if SOC_FR8029D
```
