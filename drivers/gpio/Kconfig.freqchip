## drivers/gpio/Kconfig.freqchip
```kconfig
# Copyright (c) 2025 Freqchip
# SPDX-License-Identifier: Apache-2.0

config GPIO_FREQCHIP
	bool "GPIO Driver for Freqchip family of MCUs"
	default y
	depends on DT_HAS_FREQCHIP_FREQCHIP_GPIO_ENABLED
	help 
		Enable GPIO driver for Freqchip line of MCUs
```
